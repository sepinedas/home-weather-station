## components/crowpanel_epaper_driver_component/Kconfig
```kconfig
menu "CrowPanel E-Paper Configuration"

    choice CROWPANEL_EPAPER_MODEL
        prompt "E-Paper Display Model"
        default CROWPANEL_EPAPER_4_2_INCH
        help
            Select the CrowPanel E-Paper display model.

        config CROWPANEL_EPAPER_4_2_INCH
            bool "4.2 Inch (400x300)"
        
        config CROWPANEL_EPAPER_2_13_INCH
            bool "2.13 Inch (122x250)"
    endchoice

    config CROWPANEL_EPAPER_SPI_HOST
        int "SPI Host Number (1=SPI2_HOST, 2=SPI3_HOST)"
        default 1
        help
            SPI Host to use. 1 is usually SPI2_HOST (FSPI), 2 is SPI3_HOST (HSPI).
    
    config CROWPANEL_EPAPER_SPI_MOSI
        int "SPI MOSI Pin"
        default 11
        help
            GPIO number for SPI MOSI.
    
    config CROWPANEL_EPAPER_SPI_CLK
        int "SPI CLK Pin"
        default 12
        help
            GPIO number for SPI CLK.
    
    config CROWPANEL_EPAPER_SPI_CS
        int "SPI CS Pin"
        default 14 if CROWPANEL_EPAPER_2_13_INCH
        default 45
        help
            GPIO number for SPI CS (Chip Select).
    
    config CROWPANEL_EPAPER_DC_PIN
        int "DC Pin"
        default 13 if CROWPANEL_EPAPER_2_13_INCH
        default 46
        help
            GPIO number for DC (Data/Command).
    
    config CROWPANEL_EPAPER_RST_PIN
        int "RST Pin"
        default 10 if CROWPANEL_EPAPER_2_13_INCH
        default 47
        help
            GPIO number for RST (Reset).
    
    config CROWPANEL_EPAPER_BUSY_PIN
        int "BUSY Pin"
        default 9 if CROWPANEL_EPAPER_2_13_INCH
        default 48
        help
            GPIO number for BUSY.
    
    config CROWPANEL_EPAPER_POWER_PIN
        int "Power Control Pin"
        default 7
        help
            GPIO number for Power Control (set -1 to disable).

endmenu
```

## main/Kconfig.projbuild
```kconfig
menu "E-paper Clock Configuration"

config CLOCK_WIFI_SSID
    string "WiFi SSID"
    default "myssid"

config CLOCK_WIFI_PASSWORD
    string "WiFi Password"
    default "mypassword"

config CLOCK_TZ
    string "POSIX timezone string"
    default "CST6"
    help
        Examples: "CST6" (Costa Rica, UTC-6),
        "EST5EDT,M3.2.0,M11.1.0" (US Eastern),
        "CET-1CEST,M3.5.0,M10.5.0/3" (Central Europe).

endmenu
```

## sdkconfig.defaults
```kconfig
CONFIG_IDF_TARGET="esp32s3"
CONFIG_ESPTOOLPY_FLASHSIZE_8MB=y

# --- LVGL: renders normally in 16bpp; lvgl_ui.c's flush_cb thresholds ---
# --- each pixel's brightness down to the SSD1680's 1bpp framebuffer.  ---
# (LV_COLOR_DEPTH=1 + set_px_cb was tried first but crashed inside
# LVGL's label draw routines - a much less exercised code path - so
# this sticks to the standard, well tested full-color render.)
CONFIG_LV_COLOR_DEPTH_16=y

# lvgl_ui.c drives lv_tick_inc() itself from esp_timer, so no custom tick
# Kconfig is needed here (and none of it is picked up on a build that
# already has a cached sdkconfig from before this component existed).

# Fonts used by the clock UI (time, date, AM/PM badge)
CONFIG_LV_FONT_MONTSERRAT_14=y
CONFIG_LV_FONT_MONTSERRAT_20=y
CONFIG_LV_FONT_MONTSERRAT_48=y
CONFIG_LV_FONT_DEFAULT_MONTSERRAT_14=y

CONFIG_LV_MEM_SIZE_KILOBYTES=48
```
